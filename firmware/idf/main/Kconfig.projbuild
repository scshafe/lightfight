## firmware/idf/main/Kconfig.projbuild
```kconfig
menu "lightfight"

    choice LF_ROLE
        prompt "Role of this board"
        default LF_ROLE_BLASTER
        config LF_ROLE_BLASTER
            bool "Blaster (trigger, IR emitter)"
        config LF_ROLE_HUB
            bool "Vest hub (IR receivers, haptics)"
    endchoice

    config LF_PIN_IR_LED
        int "GPIO driving the IR LED's MOSFET gate (blaster)"
        default 3
        help
            Needs the external gate pull-down (docs/hardware.md).

    config LF_PIN_IR_WIDE
        int "GPIO driving the wide shotgun LED's MOSFET gate (blaster)"
        default 21
        help
            Needs its own gate pull-down (docs/hardware.md).

    config LF_PIN_TRIGGER
        int "GPIO of trigger A (light, silent) to ground (blaster)"
        default 5

    config LF_PIN_TRIGGER_B
        int "GPIO of trigger B (heavy, sound) to ground (blaster)"
        default 7

    config LF_PIN_TRIGGER_C
        int "GPIO of trigger C (shotgun) to ground (blaster)"
        default 2
        help
            GPIO2 is a strapping pin that must be high at reset: fit the 10 k
            pull-up to 3.3 V (docs/hardware.md).

    config LF_PIN_RELOAD
        int "GPIO of the reload switch to ground (blaster)"
        default 6

    config LF_PIN_STATUS_LED
        int "GPIO of the status LED"
        default 10

    config LF_PIN_SENSOR0
        int "GPIO of IR receiver 0, chest (hub)"
        default 3
        depends on LF_ROLE_HUB

    config LF_PIN_SENSOR1
        int "GPIO of IR receiver 1, left shoulder (hub)"
        default 2
        help
            GPIO2 is a strapping pin that must be high at reset; the receiver
            output idles high, which is what it wants.
        depends on LF_ROLE_HUB

    config LF_PIN_SENSOR2
        int "GPIO of IR receiver 2, right shoulder (hub)"
        default 5
        depends on LF_ROLE_HUB

    config LF_PIN_SENSOR3
        int "GPIO of IR receiver 3, headband front (hub)"
        default 6
        depends on LF_ROLE_HUB

    config LF_PIN_SENSOR4
        int "GPIO of IR receiver 4, headband back (hub)"
        default 7
        depends on LF_ROLE_HUB

    config LF_PIN_HAPTIC
        int "GPIO of the vibration motor's MOSFET gate (hub)"
        default 21
        depends on LF_ROLE_HUB

    config LF_PIN_BUZZER
        int "GPIO of the buzzer"
        default 20

    config LF_PIN_BATTERY
        int "ADC GPIO at the midpoint of the 2 x 220 k battery divider"
        default 4
        help
            Must be an ADC1 pin (GPIO0-4 on the C3). docs/hardware.md.

    config LF_BATTERY_CAL_PERMILLE
        int "Battery reading calibration, parts per thousand (1000 = none)"
        default 1000
        help
            Set from a multimeter reading of the cell during bench step B9.

    config LF_PIN_PAIR
        int "GPIO of the pair button to ground (BOOT on the XIAO)"
        default 9
        help
            Hold 3 s: a new phone may pair for 60 s. Hold 10 s: forget all
            paired phones.

    config LF_STANDALONE
        bool "Start a match at boot with default rules (bench use, before BLE)"
        default y

    config LF_PLAYER_ID
        int "Shooter id used while standalone (0..63)"
        range 0 63
        default 1
        depends on LF_STANDALONE

    config LF_TEAM
        int "Team used while standalone (0..7)"
        range 0 7
        default 0
        depends on LF_STANDALONE

    config LF_BENCH_AUTOFIRE
        bool "Bench: send one frame per second without the trigger"
        default n
        depends on LF_ROLE_BLASTER
        help
            For the waveform check in docs/bench.md. The frames still go
            through the emitter's safety gate; there is no continuous mode.
            Magazines are huge and cooldowns zero so a capture never stalls.

    config LF_BENCH_AUTOFIRE_MODE
        int "Bench: the firing mode the autofire uses (0 light, 1 heavy, 2 shotgun)"
        default 0
        range 0 2
        depends on LF_BENCH_AUTOFIRE

endmenu
```
